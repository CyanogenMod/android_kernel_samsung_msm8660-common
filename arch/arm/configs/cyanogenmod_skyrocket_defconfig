## drivers/i2c/chips/Kconfig
```kconfig
#
# Miscellaneous I2C chip drivers configuration
#
# *** DEPRECATED! Do not add new entries! See Makefile ***
#

menu "Miscellaneous I2C Chip support"

config SENSORS_MT9T013
	tristate "MT9T013 Camera Driver"
	depends on I2C
	default n
	help
	 MT9T013 Camera Driver implemented by HTC.

config OPTICAL_GP2A
	depends on I2C
	tristate "GP2A driver"
	default n
	help
	  This option enables proximity & light sensors using gp2a driver.

config OPTICAL_GP2AP020A00F
	depends on I2C
	tristate "GP2AP020A00F driver"
	default n
	help
	  This option enables proximity & light sensors using gp2ap020a00f driver.  	  

config OPTICAL_TAOS
	depends on I2C
	tristate "TAOS driver"
	default n
	help
	  This option enables proximity & light sensors using taos driver.
	  
config SENSORS_YDA165
	bool "YDA165 Audio Amp Driver"
	depends on I2C
	default y
	help
	 YDA165 Audio AMP

config WM8994_AMP
        bool "WM8994 Audio Amp Driver"
        depends on I2C
        default y
        help
         WM8994 Audio AMP

config USB_SWITCH_FSA9480
	tristate "FSA9480 Micro USB Switch IC Driver"
	depends on I2C
	default n
	help
	 FSA9480 Micro USB Switch IC Driver

config GYRO_K3G
	tristate "K3G driver for s5pc210"
	default n
	help
	  This option enables gyro sensors using K3G driver.

config SENSORS_K3DH
	tristate "K3DH acceleration sensor support"
	depends on I2C
        default n
	help
	  Driver for STMicroelectronic K3DH accelerometer.

config SENSORS_AK8975
	tristate "AK8975 compass support"
	default n
	depends on I2C
	help
	  If you say yes here you get support for Asahi Kasei's
	  orientation sensor AK8975.

config SENSORS_YAS529_MAGNETIC
	tristate "Yamaha YAS529 Geomagnetic Sensor"
	default n
	depends on I2C

config INPUT_YAS529_POSITION
	int "YAS529 Mounting Position on Board"
	depends on SENSORS_YAS529_MAGNETIC
	default n
	help
	  Chip mounting position (pin 1).
	    0: top, upper-left
	    1: top, upper-right
	    2: top, lower-right
	    3: top, lower-left
	    4: bottom, upper-left
	    5: bottom, upper-right
	    6: bottom, lower-right
	    7: bottom, lower-left
	    
endmenu
```

## drivers/media/nmi326/Kconfig
```kconfig
#
# Configuration for nmi_hw (ISDB-T)
#

config ISDBT_NMI
	bool "Samsung ISDB-T NMI Driver" 
	default n
	---help---
	  This is a ISDB-T for NMI Driver.

config ISDBT_NMI_DEBUG
	bool "print ISDB-T NMI debug message"
	depends on ISDBT_NMI
	default n
```

## drivers/sensors/Kconfig
```kconfig
# 
# Sensors core device. 
#

config SENSORS_CORE_P5LTE
	tristate "Sensors core"
	default n
	help
	  Say Y here to enable debugging messages for power supply class
	  and drivers.

config GYRO_K3G_P5LTE
	tristate "K3G driver"
	default n
	help
	  This option enables gyro sensors using K3G driver.

config SENSORS_AK8975_P5LTE
	tristate "AK8975 compass support"
	default n
	depends on I2C
	help
	  If you say yes here you get support for Asahi Kasei's
	  orientation sensor AK8975.

config SENSORS_K3DH_P5LTE
	tristate "K3DH acceleration sensor support"
	depends on I2C
	default n
	help
	  Driver for STMicroelectronic K3DH accelerometer.

config OPTICAL_BH1721_P5LTE
	depends on I2C
	tristate "BH1721 driver"
	default n
	help
	  This option enables light sensors using bh1721 driver.
```

## drivers/staging/zram/Kconfig
```kconfig
config ZRAM
	tristate "Compressed RAM block device support"
	depends on BLOCK && SYSFS && ZSMALLOC
	default n
	help
	  Creates virtual block devices called /dev/zramX (X = 0, 1, ...).
	  Pages written to these disks are compressed and stored in memory
	  itself. These disks allow very fast I/O and compression provides
	  good amounts of memory savings.

	  It has several use cases, for example: /tmp storage, use as swap
	  disks and maybe many more.

	  See zram.txt for more information.
	  Project home: <https://compcache.googlecode.com/>

config ZRAM_DEBUG
	bool "Compressed RAM block device debug support"
	depends on ZRAM
	default n
	help
	  This option adds additional debugging code to the compressed
	  RAM block device driver.

choice ZRAM_COMPRESS
	prompt "compression method"
	depends on ZRAM
	default ZRAM_LZO
	help
	  Select the compression method used by zram.
	  LZO is the default. Snappy compresses a bit worse (around ~2%) but
	  much (~2x) faster, at least on x86-64.  LZ4 needs testing.
config ZRAM_LZO
	bool "LZO compression"
	select LZO_COMPRESS
	select LZO_DECOMPRESS
config ZRAM_SNAPPY
	bool "Snappy compression"
	select SNAPPY_COMPRESS
	select SNAPPY_DECOMPRESS
config ZRAM_LZ4
	bool "LZ4 compression"
	select LZ4_COMPRESS
	select LZ4_DECOMPRESS
endchoice
```

## drivers/video/msm/mhl_v1/Kconfig
```kconfig
#
# Copyright (c) 2011 Samsung Electronics Co., Ltd.
# 		http://www.samsung.com/
# Aakash Manik
#	aakash.manik@samsung.com


config VIDEO_MHL_V1
	bool "Samsung Mobile HD Link Interface"
	depends on MSM_VIDC && ARCH_MSM
	default n
	help
	  This is a MHL v1 driver customized for Qualcomm MSM8660 based chipsets.
```

## drivers/video/msm/mhl_v2/Kconfig
```kconfig
#
# Copyright (c) 2011 Samsung Electronics Co., Ltd.
#				http://www.samsung.com/
# Aakash Manik
#	aakash.manik@samsung.com
#


config VIDEO_MHL_V2
	bool "Samsung Mobile HD Link Interface"
	depends on MSM_VIDC && ARCH_MSM
	default n

config MHL_D3_SUPPORT
	bool "Support D3 mode in mhl"
	default n

config MHL_NEW_CBUS_MSC_CMD
	bool "Read DCAP for distinguish TA and USB"
	default n
	---help---
	  This is a MHL v2 driver customized for Qualcomm MSM8960 based chipsets.
```

## fs/exfat/Kconfig
```kconfig
config EXFAT_FS
        tristate "exFAT File System Support"
        default n
        select NLS_UTF8
```
